## arch/arm/configs/magna_defconfig
```kconfig
# CONFIG_ARM_PATCH_PHYS_VIRT is not set
CONFIG_CROSS_COMPILE="arm-eabi-"
# CONFIG_LOCALVERSION_AUTO is not set
CONFIG_KERNEL_XZ=y
CONFIG_RD_GZIP=y
CONFIG_ZRAM=y
CONFIG_ZRAM_LZ4_COMPRESS=y
CONFIG_SYSVIPC=y
CONFIG_AUDIT=y
CONFIG_NO_HZ=y
CONFIG_HIGH_RES_TIMERS=y
CONFIG_CGROUPS=y
CONFIG_CGROUP_CPUACCT=y
CONFIG_RESOURCE_COUNTERS=y
CONFIG_CGROUP_SCHED=y
CONFIG_RT_GROUP_SCHED=y
CONFIG_BLK_DEV_INITRD=y
CONFIG_PANIC_TIMEOUT=1
CONFIG_EMBEDDED=y
# CONFIG_SLUB_DEBUG is not set
CONFIG_PROFILING=y
# CONFIG_BLK_DEV_BSG is not set
CONFIG_ARCH_MT6582=y
CONFIG_MT6582_EVB_BOARD=y
CONFIG_MAX_DRAM_SIZE_SUPPORT=0x80000000
CONFIG_ARM_THUMBEE=y
CONFIG_SMP=y
CONFIG_PREEMPT=y
CONFIG_AEABI=y
# CONFIG_OABI_COMPAT is not set
CONFIG_HIGHMEM=y
CONFIG_SECCOMP=y
CONFIG_CMDLINE="console=tty0 console=ttyMT3,921600n1 root=/dev/ram vmalloc=496M slub_max_order=0 slub_debug=O "
CONFIG_CPU_FREQ=y
CONFIG_CPU_FREQ_STAT_DETAILS=y
CONFIG_CPU_FREQ_DEFAULT_GOV_HOTPLUG=y
CONFIG_CPU_FREQ_GOV_POWERSAVE=y
CONFIG_CPU_FREQ_GOV_USERSPACE=y
CONFIG_VFP=y
CONFIG_NEON=y
# CONFIG_CORE_DUMP_DEFAULT_ELF_HEADERS is not set
CONFIG_HIBERNATION=y
# CONFIG_TOI_FILE is not set
CONFIG_TOI_DEFAULT_WAIT=2
CONFIG_PM_AUTOSLEEP=y
CONFIG_PM_WAKELOCKS=y
CONFIG_NET=y
CONFIG_PACKET=y
CONFIG_UNIX=y
#CONFIG_XFRM_USER=y
CONFIG_XFRM_SUB_POLICY=y
CONFIG_XFRM_MIGRATE=y
CONFIG_NET_KEY=y
CONFIG_INET=y
CONFIG_IP_MULTICAST=y
CONFIG_IP_ADVANCED_ROUTER=y
CONFIG_IP_MULTIPLE_TABLES=y
CONFIG_IP_PNP=y
CONFIG_IP_PNP_DHCP=y
CONFIG_IP_PNP_BOOTP=y
CONFIG_NET_IPIP=y
CONFIG_IP_MROUTE=y
CONFIG_IP_MROUTE_MULTIPLE_TABLES=y
CONFIG_IP_PIMSM_V1=y
CONFIG_IP_PIMSM_V2=y
CONFIG_ARPD=y
CONFIG_SYN_COOKIES=y
CONFIG_INET_AH=y
CONFIG_INET_ESP=y
CONFIG_INET_IPCOMP=y
# CONFIG_INET_LRO is not set
CONFIG_IPV6_PRIVACY=y
CONFIG_IPV6_ROUTER_PREF=y
CONFIG_IPV6_ROUTE_INFO=y
CONFIG_IPV6_OPTIMISTIC_DAD=y
CONFIG_INET6_AH=y
CONFIG_INET6_ESP=y
CONFIG_INET6_IPCOMP=y
CONFIG_IPV6_MIP6=y
CONFIG_INET6_XFRM_MODE_ROUTEOPTIMIZATION=y
CONFIG_IPV6_SIT_6RD=y
CONFIG_IPV6_TUNNEL=y
CONFIG_IPV6_MULTIPLE_TABLES=y
CONFIG_IPV6_SUBTREES=y
CONFIG_IPV6_MROUTE=y
CONFIG_IPV6_PIMSM_V2=y
CONFIG_NETFILTER=y
CONFIG_NF_CONNTRACK=y
CONFIG_NF_CONNTRACK_EVENTS=y
CONFIG_NF_CT_PROTO_UDPLITE=y
CONFIG_NF_CONNTRACK_FTP=y
CONFIG_NF_CONNTRACK_PPTP=y
CONFIG_NF_CONNTRACK_SIP=y
CONFIG_NF_CONNTRACK_TFTP=y
CONFIG_NF_CT_NETLINK=y
CONFIG_NETFILTER_TPROXY=y
CONFIG_NETFILTER_XT_CONNMARK=y
CONFIG_NETFILTER_XT_TARGET_CLASSIFY=y
CONFIG_NETFILTER_XT_TARGET_IDLETIMER=y
CONFIG_NETFILTER_XT_TARGET_MARK=y
CONFIG_NETFILTER_XT_TARGET_NFLOG=y
CONFIG_NETFILTER_XT_TARGET_NFQUEUE=y
CONFIG_NETFILTER_XT_TARGET_TCPMSS=y
CONFIG_NETFILTER_XT_MATCH_CONNBYTES=y
CONFIG_NETFILTER_XT_MATCH_IPRANGE=y
CONFIG_NETFILTER_XT_MATCH_LENGTH=y
CONFIG_NETFILTER_XT_MATCH_LIMIT=y
CONFIG_NETFILTER_XT_MATCH_MAC=y
CONFIG_NETFILTER_XT_MATCH_MARK=y
CONFIG_NETFILTER_XT_MATCH_MULTIPORT=y
CONFIG_NETFILTER_XT_MATCH_POLICY=y
CONFIG_NETFILTER_XT_MATCH_PHYSDEV=y
CONFIG_NETFILTER_XT_MATCH_QTAGUID=y
CONFIG_NETFILTER_XT_MATCH_QUOTA=y
CONFIG_NETFILTER_XT_MATCH_QUOTA2=y
CONFIG_NETFILTER_XT_MATCH_QUOTA2_LOG=y
CONFIG_NETFILTER_XT_MATCH_REALM=y
CONFIG_NETFILTER_XT_MATCH_RECENT=y
CONFIG_NETFILTER_XT_MATCH_SOCKET=y
CONFIG_NETFILTER_XT_MATCH_STATE=y
CONFIG_NETFILTER_XT_MATCH_STATISTIC=y
CONFIG_NETFILTER_XT_MATCH_STRING=y
CONFIG_NETFILTER_XT_MATCH_TCPMSS=y
CONFIG_NETFILTER_XT_MATCH_TIME=y
CONFIG_NETFILTER_XT_MATCH_U32=y
CONFIG_NF_CONNTRACK_IPV4=y
CONFIG_IP_NF_IPTABLES=y
CONFIG_IP_NF_FILTER=y
CONFIG_IP_NF_TARGET_REJECT=y
CONFIG_NF_NAT_IPV4=y
CONFIG_IP_NF_TARGET_MASQUERADE=y
CONFIG_IP_NF_TARGET_NETMAP=y
CONFIG_IP_NF_TARGET_REDIRECT=y
CONFIG_IP_NF_MANGLE=y
CONFIG_IP_NF_RAW=y
CONFIG_IP_NF_ARPTABLES=y
CONFIG_NF_CONNTRACK_IPV6=y
CONFIG_IP6_NF_IPTABLES=y
CONFIG_IP6_NF_MATCH_FRAG=y
CONFIG_IP6_NF_MATCH_IPV6HEADER=y
CONFIG_IP6_NF_TARGET_HL=y
CONFIG_IP6_NF_FILTER=y
CONFIG_IP6_NF_TARGET_REJECT=y
CONFIG_IP6_NF_TARGET_REJECT_SKERR=y
CONFIG_IP6_NF_MANGLE=y
CONFIG_IP6_NF_RAW=y
CONFIG_BRIDGE=y
CONFIG_VLAN_8021Q=y
CONFIG_NET_SCHED=y
CONFIG_NET_SCH_HTB=y
CONFIG_NET_SCH_INGRESS=y
CONFIG_NET_CLS_FW=y
CONFIG_NET_CLS_U32=y
CONFIG_CLS_U32_PERF=y
CONFIG_CLS_U32_MARK=y
CONFIG_NET_CLS_FLOW=y
CONFIG_NET_CLS_ACT=y
CONFIG_NET_ACT_POLICE=y
CONFIG_NET_ACT_MIRRED=y
CONFIG_NET_ACT_IPT=y
CONFIG_NET_CLS_IND=y
CONFIG_CFG80211=y
CONFIG_NL80211_TESTMODE=y
CONFIG_CFG80211_DEVELOPER_WARNINGS=y
# CONFIG_CFG80211_DEFAULT_PS is not set
CONFIG_CFG80211_INTERNAL_REGDB=y
CONFIG_CFG80211_WEXT=y
CONFIG_MTD=y
CONFIG_MTD_BLOCK=y
CONFIG_MTD_NAND=y
CONFIG_MTD_NAND_PLATFORM=y
CONFIG_BLK_DEV_LOOP=y
# CONFIG_ANDROID_PMEM is not set
CONFIG_UID_STAT=y
CONFIG_UID_CPUTIME=y
CONFIG_MEDIATEK_SOLUTION=y
CONFIG_MTK_PLATFORM="mt6582"
CONFIG_ARCH_MTK_PROJECT="muse6582_y90_m"
CONFIG_MTK_CIRQ=y
CONFIG_HAVE_AEE_FEATURE=y
CONFIG_HAVE_XLOG_SUPPORT=y
CONFIG_HAVE_XLOG_PRINTK=y
# CONFIG_MTK_SHARED_SDCARD is not set
CONFIG_MTK_MULTI_STORAGE_SUPPORT=y
CONFIG_MTK_SECURITY_SW_SUPPORT=y
CONFIG_MTK_SENSOR_SUPPORT=y
CONFIG_CUSTOM_KERNEL_IMGSENSOR="ov8858_mipi_raw ov8858s_mipi_raw hi842_mipi_raw ov5670_mipi_raw hi553_mipi_raw"
CONFIG_CUSTOM_KERNEL_CAM_CAL_DRV="common_eeprom gt24c32a_eeprom brcb032gwz_3_eeprom at24c16d_eeprom"
CONFIG_CUSTOM_KERNEL_LCM="r69338_hd720_dsi_vdo_jdi"
CONFIG_CUSTOM_KERNEL_FLASHLIGHT="constant_flashlight"
CONFIG_MTK_MMPROFILE_SUPPORT=y
#CONFIG_CUSTOM_KERNEL_CHARGEPUMP=y
CONFIG_MTK_TC1_FEATURE=y
CONFIG_MTK_CLKMGR=y
CONFIG_MTK_AEE_FEATURE=y
CONFIG_MTK_AEE_POWERKEY_HANG_DETECT=y
# CONFIG_MTK_AEE_MRDUMP is not set
# CONFIG_ANDROID_VMEM is not set
CONFIG_MTK_RAM_CONSOLE=y
CONFIG_MTK_RAM_CONSOLE_USING_SRAM=y
CONFIG_MTK_RAM_CONSOLE_SIZE=0x1C00
CONFIG_MTK_RAM_CONSOLE_ADDR=0xF900DC00
CONFIG_MTK_RAM_CONSOLE_DRAM_SIZE=0x10000
CONFIG_MTK_RAM_CONSOLE_DRAM_ADDR=0x83F00000
CONFIG_PRINTK_PROCESS_INFO=y
CONFIG_MT_PRINTK_UART_CONSOLE=y
CONFIG_EARLY_LINUX_PORTING=y
# CONFIG_MTK_ETM is not set
# CONFIG_MTK_STORAGE_PID_LOGGER is not set
CONFIG_GATOR_DRIVER=y
CONFIG_MTK_TETHERINGIPV6_SUPPORT=y
CONFIG_MTK_ACCDET=y
CONFIG_MTK_FB=y
# CONFIG_MTK_FB_SUPPORT_ASSERTION_LAYER is not set
CONFIG_MTK_DITHERING_SUPPORT=y
CONFIG_MTK_LCM_PHYSICAL_ROTATION="0"
CONFIG_LCM_HEIGHT="1280"
CONFIG_LCM_WIDTH="720"
CONFIG_LCM_SEND_CMD_IN_VIDEO=y
CONFIG_MTK_BTIF=y
CONFIG_MTK_FM=y
CONFIG_MTK_FM_SUPPORT=y
CONFIG_MTK_FM_CHIP="MT6627_FM"
CONFIG_MTK_IDLE_TIME_FIX=y
# CONFIG_POWER_EXT is not set
# CONFIG_MTK_RT9536_SUPPORT is not set
CONFIG_MTK_TOUCHPANEL=y
# CONFIG_MTK_S3320 is not set
# CONFIG_LEDS_LM3639 is not set
# CONFIG_USB_MTK_ACM_TEMP is not set
CONFIG_USB_MTK_HDRC_GADGET=y
CONFIG_USB_MTK_HDRC_HCD=y
CONFIG_ION_MTK=y
CONFIG_MMPROFILE=y
CONFIG_MTK_STAGING=y
CONFIG_MTK_GPU_SUPPORT=y
# CONFIG_MTK_KERNEL_POWER_OFF_CHARGING is not set
CONFIG_MTK_SIM1_SOCKET_TYPE="1"
CONFIG_MTK_SIM2_SOCKET_TYPE="1"
CONFIG_MTK_BICR_SUPPORT=y
#CONFIG_MTK_LENS_DUMMYLENS_SUPPORT=y
CONFIG_MTK_LENS_DW9718AF_SUPPORT=y
CONFIG_MTK_LENS_DW9714A_SUPPORT=y
CONFIG_MTK_FMRADIO=y
CONFIG_MTK_HWMON=y
CONFIG_MTK_MT_LOGGER=y
# CONFIG_MTK_CHIP is not set
CONFIG_MTK_LENS=y
CONFIG_MTK_IMGSENSOR=y
CONFIG_MTK_CAM_CAL=y
CONFIG_MTK_FLASHLIGHT=y
CONFIG_MTK_DUM_CHAR=y
CONFIG_MTK_SYSENV=y
CONFIG_MTK_SMI_EXT=y
CONFIG_MTK_BTCVSD=y
CONFIG_MTK_SOUND_DRV=y
CONFIG_MTK_SOUND=y
CONFIG_MTK_POWER_GS=y
CONFIG_MTK_VIDEO=y
CONFIG_MTK_COMBO=y
CONFIG_MTK_COMBO_CHIP_CONSYS_6582=y
CONFIG_MTK_COMBO_BT=y
CONFIG_MTK_COMBO_GPS=y
CONFIG_MTK_COMBO_WIFI=y
CONFIG_MTK_PASSPOINT_R1_SUPPORT=y
CONFIG_MTK_GPS_SUPPORT=y
CONFIG_MTK_KEYPAD=y
CONFIG_KEYBOARD_HID=y
CONFIG_MTK_LEDS=y
# CONFIG_MTK_SPI is not set
CONFIG_MTK_MMC=y
CONFIG_MTK_EMMC_SUPPORT=y
CONFIG_MTK_VIDEOCODEC_DRIVER=y
CONFIG_MD1_SIZE=0x01600000
CONFIG_MTK_CCCI_EXT=y
CONFIG_MTK_CCCI_DRIVER=y
CONFIG_CUSTOM_KERNEL_SSW="ssw_single"
CONFIG_MTK_GPU_VERSION="mali utgard"
CONFIG_MTK_JPEG=y
CONFIG_MT_SCHED=y
CONFIG_MTK_SCHED_RQAVG_KS=y
CONFIG_MTK_SYNC=y
CONFIG_CUSTOM_KERNEL_ACCELEROMETER=y
#CONFIG_MTK_BMA255_SDO1=y
CONFIG_CUSTOM_KERNEL_ALSPS=y
CONFIG_MTK_AUTO_DETECT_ALSPS=y
#CONFIG_CUSTOM_KERNEL_GYROSCOPE=y
CONFIG_CUSTOM_KERNEL_MAGNETOMETER=y
# CONFIG_SCSI is not set
# CONFIG_SCSI_TGT is not set
# CONFIG_SCSI_MULTI_LUN is not set
# CONFIG_SCSI_SCAN_ASYNC is not set
CONFIG_MTK_PERFMGR_TOUCH_BOOST=y
CONFIG_BLK_DEV_SD=y
# CONFIG_SCSI_LOWLEVEL is not set
CONFIG_MD=y
CONFIG_BLK_DEV_DM=y
CONFIG_DM_CRYPT=y
CONFIG_DM_UEVENT=y
CONFIG_NETDEVICES=y
CONFIG_IFB=y
CONFIG_TUN=y
# CONFIG_ETHERNET is not set
CONFIG_PPP=y
CONFIG_PPP_BSDCOMP=y
CONFIG_PPP_DEFLATE=y
CONFIG_PPP_FILTER=y
CONFIG_PPP_MPPE=y
CONFIG_PPP_MULTILINK=y
CONFIG_PPPOE=y
CONFIG_PPPOLAC=y
CONFIG_PPPOPNS=y
CONFIG_PPP_ASYNC=y
CONFIG_PPP_SYNC_TTY=y
CONFIG_INPUT_EVDEV=y
# CONFIG_KEYBOARD_ATKBD is not set
# CONFIG_MOUSE_PS2 is not set
# CONFIG_INPUT_MOUSEDEV is not set
# CONFIG_INPUT_MOUSE is not set
CONFIG_INPUT_TOUCHSCREEN=y
CONFIG_TOUCHSCREEN_MTK=y
CONFIG_INPUT_MISC=y
CONFIG_INPUT_UINPUT=y
# CONFIG_SERIO is not set
# CONFIG_VT is not set
CONFIG_LEGACY_PTY_COUNT=16
# CONFIG_DEVMEM is not set
# CONFIG_DEVKMEM is not set
# CONFIG_HW_RANDOM is not set
CONFIG_I2C=y
CONFIG_SPI=y
#CONFIG_PINCTRL is not set

#
# Pin controllers
#
# CONFIG_PINMUX is not set
#CONFIG_PINCONF is not set
#CONFIG_GENERIC_PINCONF=y
# CONFIG_DEBUG_PINCTRL is not set
# CONFIG_PINCTRL_EXYNOS5440 is not set
# CONFIG_PINCTRL_MTK_COMMON is not set
# CONFIG_PINCTRL_MT6735 is not set
# CONFIG_PINCTRL_MT6580 is not set
CONFIG_POWER_SUPPLY=y
# CONFIG_HWMON is not set
CONFIG_THERMAL=y
CONFIG_THERMAL_DEFAULT_GOV_BACKWARD_COMPATIBLE=y
CONFIG_FB=y
CONFIG_FB_MODE_HELPERS=y
CONFIG_FB_TILEBLITTING=y
CONFIG_SOUND=y
CONFIG_SND=y
CONFIG_SND_PCM_OSS=y
# CONFIG_SND_PCM_OSS_PLUGINS is not set
# CONFIG_SND_SUPPORT_OLD_API is not set
# CONFIG_SND_ARM is not set
# CONFIG_SND_SPI is not set
CONFIG_SND_RAWMIDI=y
CONFIG_SND_USB_AUDIO=y
CONFIG_UHID=y
CONFIG_HID_A4TECH=y
CONFIG_HID_APPLE=y
CONFIG_HID_BELKIN=y
CONFIG_HID_CHERRY=y
CONFIG_HID_CHICONY=y
CONFIG_HID_CYPRESS=y
CONFIG_HID_DRAGONRISE=y
CONFIG_HID_EZKEY=y
CONFIG_HID_KYE=y
CONFIG_HID_GYRATION=y
CONFIG_HID_TWINHAN=y
CONFIG_HID_KENSINGTON=y
CONFIG_HID_LOGITECH=y
CONFIG_HID_MICROSOFT=y
CONFIG_HID_MONTEREY=y
CONFIG_HID_NTRIG=y
CONFIG_HID_PANTHERLORD=y
CONFIG_HID_PETALYNX=y
CONFIG_HID_SAMSUNG=y
CONFIG_HID_SONY=y
CONFIG_HID_SUNPLUS=y
CONFIG_HID_GREENASIA=y
CONFIG_HID_SMARTJOYPLUS=y
CONFIG_HID_TOPSEED=y
CONFIG_HID_THRUSTMASTER=y
CONFIG_HID_ZEROPLUS=y
CONFIG_USB=y
CONFIG_USB_ACM=y
CONFIG_USB_PRINTER=y
CONFIG_USB_STORAGE=y
CONFIG_USB_STORAGE_DATAFAB=y
CONFIG_USB_STORAGE_FREECOM=y
CONFIG_USB_STORAGE_ISD200=y
CONFIG_USB_STORAGE_USBAT=y
CONFIG_USB_STORAGE_SDDR09=y
CONFIG_USB_STORAGE_SDDR55=y
CONFIG_USB_STORAGE_JUMPSHOT=y
CONFIG_USB_STORAGE_ALAUDA=y
CONFIG_USB_STORAGE_ONETOUCH=y
CONFIG_USB_STORAGE_KARMA=y
CONFIG_USB_STORAGE_CYPRESS_ATACB=y
CONFIG_USB_TRANCEVIBRATOR=y
CONFIG_USB_PHY=y
CONFIG_NOP_USB_XCEIV=y
CONFIG_USB_GADGET=y
CONFIG_USB_GADGET_VBUS_DRAW=500
CONFIG_USB_G_ANDROID=y
CONFIG_MMC=y
CONFIG_MMC_UNSAFE_RESUME=y
CONFIG_MMC_BLOCK_MINORS=32
CONFIG_NEW_LEDS=y
CONFIG_LEDS_CLASS=y
CONFIG_LEDS_TRIGGERS=y
CONFIG_LEDS_TRIGGER_TIMER=y
CONFIG_SWITCH=y
CONFIG_RTC_CLASS=y
CONFIG_STAGING=y
CONFIG_ANDROID=y
CONFIG_ASHMEM=y
CONFIG_ANDROID_LOGGER=y
CONFIG_ANDROID_LOW_MEMORY_KILLER=y
CONFIG_ANDROID_INTF_ALARM_DEV=y
CONFIG_SYNC=y
CONFIG_SW_SYNC=y
CONFIG_SW_SYNC_USER=y
CONFIG_ION=y
# CONFIG_IOMMU_SUPPORT is not set
CONFIG_ANDROID_BINDER_IPC=y
# CONFIG_EXT3_FS is not set
# CONFIG_EXT3_DEFAULTS_TO_ORDERED is not set
# CONFIG_EXT3_FS_POSIX_ACL is not set
CONFIG_EXT4_FS=y
# CONFIG_EXT4_USE_FOR_EXT23 is not set
CONFIG_EXT4_FS_POSIX_ACL=y
CONFIG_EXT4_FS_SECURITY=y
CONFIG_FUSE_FS=y
CONFIG_ISO9660_FS=y
CONFIG_JOLIET=y
CONFIG_ZISOFS=y
CONFIG_MSDOS_FS=y
CONFIG_VFAT_FS=y
CONFIG_TMPFS=y
CONFIG_TMPFS_POSIX_ACL=y
CONFIG_F2FS_FS=y 
CONFIG_F2FS_STAT_FS=y 
CONFIG_F2FS_FS_XATTR=y 
CONFIG_F2FS_FS_POSIX_ACL=y 
CONFIG_F2FS_FS_SECURITY=y
CONFIG_F2FS_FS_ENCRYPTION=y 
CONFIG_NLS_CODEPAGE_437=y
CONFIG_NLS_CODEPAGE_950=y
CONFIG_NLS_ASCII=y
CONFIG_NLS_ISO8859_1=y
CONFIG_NLS_UTF8=y
CONFIG_PRINTK_TIME=y
CONFIG_FRAME_WARN=1400
CONFIG_MAGIC_SYSRQ=y
CONFIG_PANIC_ON_OOPS=y
CONFIG_SCHEDSTATS=y
# CONFIG_DEBUG_BUGVERBOSE is not set
CONFIG_DEBUG_INFO=y
CONFIG_RCU_CPU_STALL_TIMEOUT=60
CONFIG_FUNCTION_TRACER=y
# CONFIG_DYNAMIC_DEBUG is not set
# CONFIG_KGDB is not set
# CONFIG_KGDB_KDB is not set
# CONFIG_ARM_UNWIND is not set
CONFIG_DEBUG_RODATA=y
CONFIG_SECURITY=y
CONFIG_SECURITY_NETWORK=y
CONFIG_SECURITY_SELINUX=y
CONFIG_SECURITY_SELINUX_BOOTPARAM=y

CONFIG_CRYPTO_CTR=y
CONFIG_CRYPTO_XCBC=y
CONFIG_CRYPTO_SHA256=y
CONFIG_CRYPTO_TWOFISH=y
CONFIG_CRYPTO_LZO=y
# CONFIG_CRYPTO_ANSI_CPRNG is not set
# CONFIG_CRYPTO_HW is not set
CONFIG_LIBCRC32C=y
#
# LGE Board Support Package
#
CONFIG_MACH_LGE=y

#
# LGE Board Selection
#
CONFIG_MACH_MT6582=y
# LGE Specific Patches
#
CONFIG_LGE_BOOTLOADER_LOG=y
CONFIG_DEBUG_USER_INIT=y
CONFIG_LGE_USE_SEPERATE_GAIN=y
CONFIG_LGE_CABLE_ID_DETECT=y
# CONFIG_LGE_LUT_KCAL is not set
CONFIG_LGE_HANDLE_PANIC=y
CONFIG_LGE_HIDDEN_RESET=y
# CONFIG_LGE_LCD_DYNAMIC_LOG is not set
CONFIG_LGE_KSWITCH=y
CONFIG_LGE_PM=y
CONFIG_LGE_PM_CHARGING_SCENARIO=y
CONFIG_LGE_PM_CHARGERLOGO=y
CONFIG_LGE_PM_BATTERY_PRESENT=y
CONFIG_LGE_PM_BATTERY_ID=y
CONFIG_LGE_PM_BATTERY_PROFILE=y
CONFIG_LGE_PM_SOC_SCALE=y
CONFIG_LGE_PM_PSEUDO_BATTERY=y
CONFIG_LGE_PM_USB_CURRENT_MAX=y
CONFIG_LGE_PM_AT_CMD_SUPPORT=y
CONFIG_LGE_PM_HIDDEN_MENU_TIMER_DISABLE=y
#LGE_FACTORY PRE_SELFD
CONFIG_PRE_SELF_DIAGNOSIS=y
#
# LGE Devices : NFC
#
# CONFIG_NFC is not set
# CONFIG_LGE_NFC is not set
# CONFIG_NFC_BCM2079X is not set
# LGE Devices : LCD
CONFIG_BACKLIGHT_LM3639=y 
# LGE Devices : Touch
CONFIG_JDI_INCELL=y
# LGE Devices : Memory
CONFIG_LGE_MMC_RESET_IF_HANG=y
# LGE Devices : Sensor
#
CONFIG_MTK_APDS9130=y
CONFIG_BU52061NVX=y
CONFIG_BOSCH_BMA255=y
CONFIG_BOSCH_BMM050=y
CONFIG_ROHM_RPR0521=y
# Enable SREADAHEAD Function : Enhancement for Booting Time
CONFIG_LGE_SREADAHEAD=y
CONFIG_READAHEAD_MMAP_SIZE_ENABLE=y
CONFIG_READAHEAD_MMAP_PAGE_CNT=8
CONFIG_LGE_AUTO_DETECT_ALSPS=y
# LGE Devices : USB
#
CONFIG_LGE_USB_G_ANDROID=y
#CONFIG_LGE_USB_G_ANDROID_AUTORUN is not set
CONFIG_LGE_USB_G_MULTIPLE_CONFIGURATION=y

#Temporarily commented to resolve build error after taking P1s3g kernel delta changes
# LGE Devices : Power
CONFIG_MTK_EXTERNAL_CHARGER_RT9536=y
CONFIG_MTK_EXTERNAL_CHARGER_SUPPORT=y





# LGE Devices : RTC
#
CONFIG_RTC_INTF_SECCLK=y

#
# LGE Devices : VPN
#
CONFIG_PPPOL2TP=y
CONFIG_MPPE=y
CONFIG_L2TP=y
CONFIG_XFRM_USER=y
CONFIG_CRYPTO_NULL=y

#
# LGE Devices : Encryption
#
CONFIG_ECRYPT_FS=y
CONFIG_EXPERIMENTAL=y
CONFIG_KEYS=y
CONFIG_ENCRYPTED_KEYS=y
CONFIG_SD_ENCRYPTION_MANAGER=y
# Performance Patches
CONFIG_BALANCE_ANON_FILE_RECLAIM=y

# CONFIG_RPS is not set
# CONFIG_RFS_ACCEL is not set
# CONFIG_MTK_EXTERNAL_CHARGER_MAX8971 is not set
# CONFIG_DECOMPRESS_GZIP is not set
```
